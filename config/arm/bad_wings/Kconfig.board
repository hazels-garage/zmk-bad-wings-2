## config/arm/bad_wings/Kconfig.board
```kconfig
# Copyright (c) 2023 The ZMK Contributors
# SPDX-License-Identifier: MIT

config BOARD_BAD_WINGS
    bool "Bad Wings v2"
    depends on SOC_STM32F072XB
```

## config/boards/arm/bad_wings/Kconfig.board
```kconfig
# Copyright (c) 2023 The ZMK Contributors
# SPDX-License-Identifier: MIT

config BOARD_BAD_WINGS
    bool "BadWings"
    depends on SOC_STM32F072XB
```

## config/boards/arm/bw2/Kconfig.defconfig
```kconfig
# Copyright (c) 2020 The ZMK Contributors
# SPDX-License-Identifier: MIT

if BOARD_BW2

config BOARD
    default "bw2"

config ZMK_KEYBOARD_NAME
    default "Bad Wings v2"

config ZMK_USB
    default y

config ZMK_KSCAN_MATRIX_POLLING
    default y

endif 

if ZMK_STUDIO

choice ZMK_BEHAVIOR_LOCAL_ID_TYPE
    default ZMK_BEHAVIOR_LOCAL_ID_TYPE_CRC16
endchoice 

config ZMK_STUDIO_RPC_TX_BUF_SIZE
    default 32

endif
```

## config/boards/arm/bw2/bw2_defconfig
```kconfig
# SPDX-License-Identifier: MIT

CONFIG_BOARD_BW2=y
CONFIG_SOC_SERIES_STM32F0X=y
CONFIG_SOC_STM32F072XB=y
# 48MHz system clock
CONFIG_SYS_CLOCK_HW_CYCLES_PER_SEC=48000000

# enable PINMUX
CONFIG_PINCTRL=y

# enable GPIO
CONFIG_GPIO=y

# Enable i2c
# CONFIG_I2C=y
CONFIG_SPI=n

# ZMK Settings
CONFIG_ZMK_USB=y
# CONFIG_ZMK_KSCAN_MATRIX_POLLING=y
CONFIG_USB_SELF_POWERED=n

# Needed to reduce this to size that will fit on F072
CONFIG_KERNEL_MEM_POOL=n
CONFIG_HEAP_MEM_POOL_SIZE=0

# clock configuration
CONFIG_CLOCK_CONTROL=y

CONFIG_ZMK_STUDIO=y

# ZMK Studio Settings
CONFIG_ZMK_BEHAVIOR_LOCAL_ID_TYPE_CRC16=y
CONFIG_ZMK_STUDIO_RPC_THREAD_STACK_SIZE=3000
CONFIG_ZMK_STUDIO_RPC_TX_BUF_SIZE=32
CONFIG_ZMK_KEYMAP_LAYER_NAME_MAX_LEN=10
CONFIG_FLASH=y
CONFIG_FLASH_MAP=y
CONFIG_NVS=y

# Zephyr Memory Reduction Settings
CONFIG_IDLE_STACK_SIZE=128
CONFIG_ISR_STACK_SIZE=756
CONFIG_MAIN_STACK_SIZE=756
CONFIG_USB_CDC_ACM_RINGBUF_SIZE=128
CONFIG_USB_WORKQUEUE_STACK_SIZE=756

# ZMK Specific Memory Reduction
CONFIG_ZMK_BEHAVIOR_HOLD_TAP_MAX_HELD=3
CONFIG_ZMK_BEHAVIOR_HOLD_TAP_MAX_CAPTURED_EVENTS=15
CONFIG_ZMK_BEHAVIOR_STICKY_KEY_MAX_HELD=3
CONFIG_ZMK_BEHAVIORS_QUEUE_SIZE=8
CONFIG_ZMK_COMBO_MAX_PRESSED_COMBOS=1
CONFIG_ZMK_COMBO_MAX_COMBOS_PER_KEY=3
CONFIG_ZMK_COMBO_MAX_KEYS_PER_COMBO=2
```
